## soc/arm/st_bluenrg/Kconfig
```kconfig
# ST Microelectronics BlueNRG2 MCU line

# Copyright (c) 2020 Teltonika Telemedic
# SPDX-License-Identifier: Apache-2.0

config SOC_FAMILY_BLUENRG
	bool
	select HAS_SEGGER_RTT

if SOC_FAMILY_BLUENRG

config SOC_FAMILY
	string
	default "st_bluenrg"

source "soc/arm/st_bluenrg/*/Kconfig.soc"

endif # SOC_FAMILY_BLUENRG
```

## soc/arm/st_bluenrg/Kconfig.soc
```kconfig
# ST Microelectronics BlueNRG2 MCU line

# Copyright (c) 2020 Teltonika Telemedic
# SPDX-License-Identifier: Apache-2.0

source "soc/arm/st_bluenrg/*/Kconfig.series"
```

## soc/arm/st_bluenrg/bluenrg2/Kconfig.defconfig.bluenrg232
```kconfig
# Copyright (c) 2020 Teltonika Telemedic
# SPDX-License-Identifier: Apache-2.0

if SOC_BLUENRG232

config SOC
	default "bluenrg232"

config NUM_IRQS
	default 48

config NUM_GPIOS
	default 14

endif # SOC_BLUENRG232
```

## soc/arm/st_bluenrg/bluenrg2/Kconfig.defconfig.bluenrg234
```kconfig
# Copyright (c) 2020 Teltonika Telemedic
# SPDX-License-Identifier: Apache-2.0

if SOC_BLUENRG234

config SOC
	default "bluenrg234"

config NUM_IRQS
	default 48

config NUM_GPIOS
	default 15

endif # SOC_BLUENRG234
```

## soc/arm/st_bluenrg/bluenrg2/Kconfig.defconfig.bluenrg248
```kconfig
# Copyright (c) 2020 Teltonika Telemedic
# SPDX-License-Identifier: Apache-2.0

if SOC_BLUENRG248

config SOC
	default "bluenrg248"

config NUM_IRQS
	default 48

config NUM_GPIOS
	default 26

endif # SOC_BLUENRG248
```

## soc/arm/st_bluenrg/bluenrg2/Kconfig.soc
```kconfig
# ST Microelectronics BlueNRG2 MCU line

# Copyright (c) 2020 Teltonika Telemedic
# SPDX-License-Identifier: Apache-2.0

choice
	prompt "BlueNRG2 MCU Selection"
	depends on SOC_SERIES_BLUENRG2

config SOC_BLUENRG232
	bool "BLUENRG232"

config SOC_BLUENRG234
	bool "BLUENRG234"

config SOC_BLUENRG248
	bool "BLUENRG248"

endchoice
```
